## config/west.yml
```yaml
manifest:
  remotes:
    - name: zmkfirmware
      url-base: https://github.com/zmkfirmware
    - name: cannonkeys
      url-base: https://github.com/cannonkeys
    - name: awkannan
      url-base: https://github.com/awkannan
  projects:
    - name: zmk
      remote: zmkfirmware
      revision: v0.3
      import: app/west.yml
    - name: zmk-cannonkeys-keyboards
      remote: cannonkeys
      revision: main
    # Provides GPIO control behavior (C implementation) required by Photon
    - name: zmk-gpio-behavior
      remote: awkannan
      revision: main
  self:
    path: config
```
